## sysbuild.conf
```
SB_CONFIG_MCUBOOT_NRF53_MULTI_IMAGE_UPDATE=y
```

## prj.conf
```kconfig
# Copyright (c) 2023 Bjarki Arge Andreasen
# SPDX-License-Identifier: Apache-2.0
CONFIG_POSIX_API=y

# Networking
CONFIG_NETWORKING=y
CONFIG_NET_NATIVE=y
CONFIG_NET_L2_PPP=y
CONFIG_NET_IPV4=y
CONFIG_NET_UDP=y
CONFIG_NET_TCP=y
# TLS/HTTP over PPP needs more than the default 4 packets / 16 buffers of 128 bytes
CONFIG_NET_PKT_RX_COUNT=16
CONFIG_NET_PKT_TX_COUNT=16
CONFIG_NET_BUF_RX_COUNT=48
CONFIG_NET_BUF_TX_COUNT=48
CONFIG_NET_SOCKETS=y
CONFIG_NET_CONTEXT_RCVTIMEO=y

# DNS
CONFIG_DNS_RESOLVER=y
CONFIG_NET_L2_PPP_OPTION_DNS_USE=y

# Network management
CONFIG_NET_MGMT=y
CONFIG_NET_MGMT_EVENT=y
CONFIG_NET_CONNECTION_MANAGER=y

# Modem driver
CONFIG_MODEM=y
CONFIG_PM_DEVICE=y
CONFIG_MODEM_CELLULAR=y

# Dynamic APN configuration (uncomment if not needed)
#CONFIG_MODEM_CELLULAR_APN="" # Remove default APN
#CONFIG_SAMPLE_CELLULAR_MODEM_AUTO_APN=y
#CONFIG_SAMPLE_CELLULAR_APN_0="shared.m2m.ch"
#CONFIG_SAMPLE_CELLULAR_IMSI_LIST_0="22801"
#CONFIG_SAMPLE_CELLULAR_APN_1="em"
#CONFIG_SAMPLE_CELLULAR_IMSI_LIST_1="29505 90143 29509"

# Statistics
CONFIG_MODEM_STATS=y
CONFIG_SHELL=y

# Testing
CONFIG_MODEM_AT_SHELL=y
CONFIG_MODEM_CELLULAR_SHELL=y
CONFIG_PM_DEVICE_SHELL=y
CONFIG_SHELL_WILDCARD=n

# MCUboot image confirmation
CONFIG_FLASH=y
CONFIG_FLASH_MAP=y
CONFIG_STREAM_FLASH=y
CONFIG_IMG_MANAGER=y
CONFIG_MCUBOOT_IMG_MANAGER=y
CONFIG_DFU_TARGET=y
CONFIG_DFU_TARGET_MCUBOOT=y

# Logging
CONFIG_LOG=y
CONFIG_MODEM_MODULES_LOG_LEVEL_INF=y
# For extra verbosity
#CONFIG_MODEM_CMUX_LOG_LEVEL_DBG=y
#CONFIG_LOG_BUFFER_SIZE=65536

# Memfault
CONFIG_MEMFAULT=y
CONFIG_MEMFAULT_HTTP_ENABLE=y
# Get your project key from Memfault: Settings -> Project Key
CONFIG_MEMFAULT_PROJECT_KEY="LXV7vTEf5rJFId8X7gUlZIbvXjF05dw3"
# Device ID is the nRF9151 IMEI, set at runtime via memfault_ncs_device_id_set()
CONFIG_MEMFAULT_NCS_DEVICE_ID_RUNTIME=y

# Persist Memfault coredumps in the reserved internal-flash storage partition
CONFIG_MEMFAULT_NCS_INTERNAL_FLASH_BACKED_COREDUMP=y
CONFIG_MEMFAULT_COREDUMP_FULL_THREAD_STACKS=y
CONFIG_MEMFAULT_NCS_LTE_METRICS=n

# TLS to Memfault is terminated on this MCU, the modem only carries PPP.
# Crypto settings follow ncs-serial-modem-host-applications/applications/ppp/prj.conf
CONFIG_NET_SOCKETS_SOCKOPT_TLS=y
CONFIG_NET_SOCKETS_TLS_MAX_CONTEXTS=2
# Memfault installs 2 root certs
CONFIG_NET_SOCKETS_TLS_MAX_CREDENTIALS=4
CONFIG_TLS_CREDENTIALS=y
CONFIG_NET_SOCKETS_DNS_TIMEOUT=10000

CONFIG_MBEDTLS=y
CONFIG_MBEDTLS_ENABLE_HEAP=y
CONFIG_MBEDTLS_HEAP_SIZE=24576
# HTTPS server certificate records are larger than the 2048 used for CoAP
CONFIG_MBEDTLS_SSL_IN_CONTENT_LEN=4096
CONFIG_MBEDTLS_SSL_OUT_CONTENT_LEN=2048
CONFIG_MBEDTLS_SSL_SERVER_NAME_INDICATION=y
CONFIG_MBEDTLS_PEM_PARSE_C=y
CONFIG_MBEDTLS_DECLARE_PRIVATE_IDENTIFIERS=y

# TLS 1.2 needs at least one key exchange / ciphersuite
CONFIG_MBEDTLS_TLS_VERSION_1_2=y
CONFIG_MBEDTLS_CIPHERSUITE_TLS_ECDHE_RSA_WITH_AES_128_GCM_SHA256=y
CONFIG_MBEDTLS_CIPHERSUITE_TLS_ECDHE_RSA_WITH_AES_256_GCM_SHA384=y
CONFIG_MBEDTLS_CIPHERSUITE_TLS_ECDHE_ECDSA_WITH_AES_128_GCM_SHA256=y
CONFIG_MBEDTLS_CIPHERSUITE_TLS_ECDHE_ECDSA_WITH_AES_256_GCM_SHA384=y

# PSA algorithms for certificate chain verification
# Random number generation for the TLS handshake (client random, ephemeral keys)
CONFIG_PSA_CRYPTO=y
CONFIG_PSA_WANT_GENERATE_RANDOM=y
CONFIG_PSA_WANT_ALG_SHA_256=y
CONFIG_PSA_WANT_ALG_SHA_1=y
CONFIG_PSA_WANT_ALG_SHA_224=y
CONFIG_PSA_WANT_ALG_SHA_512=y
CONFIG_PSA_WANT_ALG_ECDH=y
CONFIG_PSA_WANT_ALG_ECDSA=y
CONFIG_PSA_WANT_ECC_SECP_R1_256=y
CONFIG_PSA_WANT_ECC_SECP_R1_384=y
CONFIG_PSA_WANT_KEY_TYPE_ECC_KEY_PAIR_EXPORT=y
CONFIG_PSA_WANT_KEY_TYPE_ECC_KEY_PAIR_GENERATE=y
CONFIG_PSA_WANT_KEY_TYPE_ECC_KEY_PAIR_DERIVE=y
CONFIG_PSA_WANT_ALG_RSA_PKCS1V15_SIGN=y
CONFIG_PSA_WANT_KEY_TYPE_RSA_PUBLIC_KEY=y
CONFIG_PSA_WANT_KEY_TYPE_RSA_KEY_PAIR_IMPORT=y

# DNS fallbacks in case PPP does not provide servers
CONFIG_DNS_RESOLVER_MAX_SERVERS=4
# Must be >= the number of DNS servers the dispatcher polls
CONFIG_ZVFS_POLL_MAX=8
CONFIG_DNS_SERVER_IP_ADDRESSES=y
CONFIG_DNS_SERVER1="8.8.8.8"
CONFIG_DNS_SERVER2="1.1.1.1"

CONFIG_HEAP_MEM_POOL_SIZE=16384
# TLS handshake and certificate verification run on the main thread
CONFIG_MAIN_STACK_SIZE=8192
CONFIG_SYSTEM_WORKQUEUE_STACK_SIZE=3072

# Temporary: TLS handshake debugging
# CONFIG_NET_LOG=y
# CONFIG_NET_SOCKETS_LOG_LEVEL_DBG=y
# CONFIG_LOG_BUFFER_SIZE=8192
# CONFIG_MBEDTLS_DEBUG=y
# CONFIG_MBEDTLS_LOG_LEVEL_DBG=y
# CONFIG_MEMFAULT_LOG_LEVEL_DBG=y

CONFIG_ZCBOR=y

# OTA bundle download to the /ota file system (external flash)
CONFIG_DOWNLOADER=y
CONFIG_DOWNLOADER_TRANSPORT_HTTP=y
CONFIG_DOWNLOADER_STACK_SIZE=8192
CONFIG_DOWNLOADER_MAX_HOSTNAME_SIZE=64
CONFIG_DOWNLOADER_MAX_FILENAME_SIZE=256

CONFIG_REBOOT=y
CONFIG_FILE_SYSTEM=y
CONFIG_FILE_SYSTEM_SHELL=y

CONFIG_FLASH_SHELL=y
```

## src/main.c
```c
/*
 * Copyright (c) 2023, Bjarki Arge Andreasen
 *
 * SPDX-License-Identifier: Apache-2.0
 */

#include <string.h>

#include <zephyr/device.h>
#include <zephyr/kernel.h>
#include <zephyr/logging/log.h>
#include <zephyr/net/net_if.h>
#include <zephyr/net/net_mgmt.h>
#include <zephyr/pm/device.h>
#include <zephyr/drivers/cellular.h>
#include <zephyr/shell/shell.h>
#include <zephyr/sys/atomic.h>

#include <memfault/components.h>
#include <memfault/ports/zephyr/http.h>
#include <memfault/ports/zephyr/root_cert_storage.h>
#include <memfault_ncs.h>

#include <zephyr/dfu/mcuboot.h>

#include "ota_download.h"

LOG_MODULE_REGISTER(main, LOG_LEVEL_INF);

static const int memfault_sec_tags[] = {
    kMemfaultRootCert_DigicertRootG2,
    kMemfaultRootCert_AmazonRootCa1,
};

#define L4_EVENT_MASK \
	(NET_EVENT_L4_CONNECTED | NET_EVENT_L4_DISCONNECTED | NET_EVENT_DNS_SERVER_ADD)
#define L4_CONNECTED 1
#define L4_DNS_ADDED 2
#define APP_READY 4

#define IMEI_LEN 15

const struct device *modem = DEVICE_DT_GET(DT_ALIAS(modem));

static struct net_if *ppp_iface;
static K_EVENT_DEFINE(l4_event);

enum ota_operation {
	OTA_IDLE,
	OTA_DOWNLOAD,
	OTA_APPLY,
};

static atomic_t ota_operation;
static K_SEM_DEFINE(ota_request, 0, 1);

static void l4_event_handler(uint64_t event, struct net_if *iface, void *info, size_t info_length,
			     void *user_data)
{
	if (iface != ppp_iface) {
		return;
	}

	switch (event) {
	case NET_EVENT_L4_CONNECTED:
		k_event_post(&l4_event, L4_CONNECTED);
		break;
	case NET_EVENT_DNS_SERVER_ADD:
		k_event_post(&l4_event, L4_DNS_ADDED);
		break;
	case NET_EVENT_L4_DISCONNECTED:
		k_event_clear(&l4_event, L4_CONNECTED | L4_DNS_ADDED);
		break;
	default:
		break;
	}
}

NET_MGMT_REGISTER_EVENT_HANDLER(l4_events, L4_EVENT_MASK, l4_event_handler, NULL);

static void ota_download_run(void)
{
	char *url = NULL;
	int ret;

	LOG_INF("Checking for OTA update");
	ret = memfault_zephyr_port_get_download_url(&url);
	if (ret < 0) {
		LOG_ERR("OTA check failed (%d)", ret);
		return;
	}
	if (ret == 0) {
		LOG_INF("Up to date");
		return;
	}

	LOG_INF("Downloading OTA bundle");
	ret = ota_bundle_download(url, memfault_sec_tags, ARRAY_SIZE(memfault_sec_tags));
	memfault_zephyr_port_release_download_url(&url);
	if (ret < 0) {
		LOG_ERR("OTA download failed (%d)", ret);
	} else {
		LOG_INF("Bundle saved to %s", OTA_BUNDLE_PATH);
	}
}

static void ota_thread_fn(void *unused1, void *unused2, void *unused3)
{
	ARG_UNUSED(unused1);
	ARG_UNUSED(unused2);
	ARG_UNUSED(unused3);

	while (true) {
		k_sem_take(&ota_request, K_FOREVER);
		if (atomic_get(&ota_operation) == OTA_DOWNLOAD) {
			ota_download_run();
		} else {
			int ret = ota_bundle_apply();

			if (ret < 0) {
				LOG_ERR("OTA apply failed (%d)", ret);
			} else {
				LOG_INF("OTA update transfer complete");
			}
		}
		atomic_set(&ota_operation, OTA_IDLE);
	}
}

K_THREAD_DEFINE(ota_thread, 8192, ota_thread_fn, NULL, NULL, NULL,
		K_LOWEST_APPLICATION_THREAD_PRIO, 0, 0);

static int ota_submit(const struct shell *sh, enum ota_operation operation)
{
	if (k_event_test(&l4_event, APP_READY) == 0) {
		shell_error(sh, "Application is not ready");
		return -EAGAIN;
	}
	if (operation == OTA_DOWNLOAD && k_event_test(&l4_event, L4_CONNECTED) == 0) {
		shell_error(sh, "Network is not ready");
		return -EAGAIN;
	}
	if (!atomic_cas(&ota_operation, OTA_IDLE, operation)) {
		shell_error(sh, "An OTA operation is already running");
		return -EBUSY;
	}
	shell_print(sh, "OTA %s queued", operation == OTA_DOWNLOAD ? "download" : "apply");
	k_sem_give(&ota_request);
	return 0;
}

static int cmd_ota_download(const struct shell *sh, size_t argc, char **argv)
{
	ARG_UNUSED(argc);
	ARG_UNUSED(argv);
	return ota_submit(sh, OTA_DOWNLOAD);
}

static int cmd_ota_apply(const struct shell *sh, size_t argc, char **argv)
{
	ARG_UNUSED(argc);
	ARG_UNUSED(argv);
	return ota_submit(sh, OTA_APPLY);
}

SHELL_STATIC_SUBCMD_SET_CREATE(ota_commands,
	SHELL_CMD_ARG(download, NULL, "Download the available Memfault OTA bundle",
		      cmd_ota_download, 1, 0),
	SHELL_CMD_ARG(apply, NULL, "Verify and apply the saved OTA bundle", cmd_ota_apply, 1, 0),
	SHELL_SUBCMD_SET_END);

SHELL_CMD_REGISTER(ota, &ota_commands, "OTA bundle operations", NULL);

static int memfault_device_id_init(void)
{
	char imei[IMEI_LEN + 1];
	int ret;

	ret = cellular_get_modem_info(modem, CELLULAR_MODEM_INFO_IMEI, imei, sizeof(imei));
	if (ret < 0) {
		LOG_ERR("Failed to get IMEI (%d)", ret);
		return ret;
	}

	LOG_INF("IMEI: %s", imei);

	return memfault_ncs_device_id_set(imei, strlen(imei));
}

int main(void)
{
	int ret;

	ppp_iface = net_if_get_first_by_type(&NET_L2_GET_NAME(PPP));

	LOG_INF("Powering on modem");
	pm_device_action_run(modem, PM_DEVICE_ACTION_RESUME);

	LOG_INF("Bring up network interface");
	ret = net_if_up(ppp_iface);
	if (ret < 0) {
		LOG_ERR("Failed to bring up network interface");
		return -1;
	}

	LOG_INF("Waiting for L4 connected");
	ret = k_event_wait(&l4_event, L4_CONNECTED, false, K_SECONDS(120));
	if (ret != L4_CONNECTED) {
		LOG_ERR("L4 was not connected in time");
		return -1;
	}

	ret = k_event_wait(&l4_event, L4_DNS_ADDED, false, K_SECONDS(10));
	if (ret != L4_DNS_ADDED) {
		LOG_ERR("DNS server was not added in time");
		return -1;
	}

	ret = memfault_device_id_init();
	if (ret < 0) {
		return -1;
	}

	ret = memfault_zephyr_port_install_root_certs();
	if (ret < 0) {
		LOG_ERR("Failed to install Memfault root certs (%d)", ret);
		return -1;
	}

	/* Capture a heartbeat now instead of waiting for the periodic timer. */
	memfault_metrics_heartbeat_debug_trigger();

	LOG_INF("Uploading data to Memfault");
	ret = memfault_zephyr_port_post_data();
	if (ret < 0) {
		LOG_ERR("Memfault upload failed (%d)", ret);
		return -1;
	}

	if (!boot_is_img_confirmed()) {
		LOG_INF("Confirming OTA update");
		ret = boot_write_img_confirmed();
		if (ret < 0) {
			LOG_ERR("Image confirmation failed (%d)", ret);
			return ret;
		}
	}

	k_event_post(&l4_event, APP_READY);
	return 0;
}
```

## src/ota_download.c
```c
/*
 * Copyright (c) 2026 Nordic Semiconductor ASA
 *
 * SPDX-License-Identifier: LicenseRef-Nordic-5-Clause
 */

#include <errno.h>
#include <stdlib.h>
#include <string.h>
#include <psa/crypto.h>

#include <zephyr/kernel.h>
#include <zephyr/fs/fs.h>
#include <zephyr/logging/log.h>
#include <zephyr/net/net_if.h>
#include <zephyr/pm/device.h>
#include <zephyr/sys/reboot.h>

#include <dfu/dfu_target_mcuboot.h>

#include <net/downloader.h>

#include "ota_download.h"
#include "sm_xdfu.h"

#include "ota_bundle_decode.h"

LOG_MODULE_REGISTER(ota_download, LOG_LEVEL_INF);

static const char *ota_target_name(int target)
{
	switch (target) {
	case ota_element_target_nrf53_app_m_c:
		return "nrf53_app";
	case ota_element_target_nrf53_net_m_c:
		return "nrf53_net";
	case ota_element_target_nrf53_bl_m_c:
		return "nrf53_bl";
	case ota_element_target_nrf91_app_m_c:
		return "nrf91_app";
	case ota_element_target_nrf91_bl_m_c:
		return "nrf91_bl";
	case ota_element_target_nrf91_mdm_delta_m_c:
		return "nrf91_mdm_delta";
	case ota_element_target_nrf91_mdm_full_m_c:
		return "nrf91_mdm_full";
	default:
		return "unknown";
	}
}

static struct downloader dl;
static struct fs_file_t ota_file;
static char dl_buf[2048] __aligned(4);
static uint8_t mcuboot_buf[1024] __aligned(4);
static K_SEM_DEFINE(dl_done, 0, 1);
static int dl_result;

static int dl_callback(const struct downloader_evt *evt)
{
	int err;

	switch (evt->id) {
	case DOWNLOADER_EVT_FRAGMENT:
		err = fs_write(&ota_file, evt->fragment.buf, evt->fragment.len);
		if (err < 0) {
			LOG_ERR("fs_write failed: %d", err);
			dl_result = err;
			return 1; /* non-zero stops the download */
		}
		return 0;

	case DOWNLOADER_EVT_ERROR:
		LOG_ERR("Download error: %d", evt->error);
		dl_result = evt->error;
		return 1; /* stop; zero would let the downloader reconnect and resume */

	case DOWNLOADER_EVT_DONE:
		dl_result = 0;
		k_sem_give(&dl_done);
		return 0;

	case DOWNLOADER_EVT_STOPPED:
		if (dl_result == 0) {
			dl_result = -ECANCELED;
		}
		k_sem_give(&dl_done);
		return 0;

	default:
		return 0;
	}
}

int ota_bundle_download(const char *url, const int *sec_tags, uint8_t sec_tag_count)
{
	struct downloader_cfg cfg = {
		.callback = dl_callback,
		.buf = dl_buf,
		.buf_size = sizeof(dl_buf),
	};
	struct downloader_host_cfg host_cfg = {
		.sec_tag_list = sec_tags,
		.sec_tag_count = sec_tag_count,
		.range_override = sizeof(dl_buf),
	};
	struct fs_statvfs sv;
	int err;

	/* Free the whole partition for the new bundle */
	(void)fs_unlink(OTA_BUNDLE_PATH);

	fs_file_t_init(&ota_file);
	err = fs_open(&ota_file, OTA_BUNDLE_PATH, FS_O_CREATE | FS_O_WRITE);
	if (err) {
		LOG_ERR("fs_open failed: %d", err);
		return err;
	}

	err = downloader_init(&dl, &cfg);
	if (err) {
		LOG_ERR("downloader_init failed: %d", err);
		goto out_close;
	}

	k_sem_reset(&dl_done);
	dl_result = 0;

	err = downloader_get(&dl, &host_cfg, url, 0);
	if (err) {
		LOG_ERR("downloader_get failed: %d", err);
		goto out_deinit;
	}

	k_sem_take(&dl_done, K_FOREVER);
	err = dl_result;

out_deinit:
	downloader_deinit(&dl);
out_close:
	fs_sync(&ota_file);
	fs_close(&ota_file);

	if (err) {
		(void)fs_unlink(OTA_BUNDLE_PATH); /* don't keep a partial bundle */
	} else if (fs_statvfs("/ota", &sv) == 0) {
		LOG_INF("Bundle stored, %lu of %lu blocks free", sv.f_bfree, sv.f_blocks);
	}

	return err;
}

static int stage_nrf53_update(int image, off_t offset, size_t length)
{
	struct fs_file_t file;
	ssize_t bytes_read;
	int err;

	if (length < sizeof(uint32_t)) {
		return -EBADMSG;
	}
	fs_file_t_init(&file);
	err = fs_open(&file, OTA_BUNDLE_PATH, FS_O_READ);
	if (err < 0) {
		return err;
	}
	err = fs_seek(&file, offset, FS_SEEK_SET);
	if (err < 0) {
		goto out_close;
	}
	bytes_read = fs_read(&file, dl_buf, sizeof(uint32_t));
	if (bytes_read != sizeof(uint32_t) || !dfu_target_mcuboot_identify(dl_buf)) {
		LOG_ERR("nRF53 image %d is not a MCUboot image", image);
		err = bytes_read < 0 ? (int)bytes_read : -EBADMSG;
		goto out_close;
	}
	err = fs_seek(&file, offset, FS_SEEK_SET);
	if (err < 0) {
		goto out_close;
	}
	err = dfu_target_mcuboot_set_buf(mcuboot_buf, sizeof(mcuboot_buf));
	if (err < 0) {
		goto out_close;
	}
	err = dfu_target_mcuboot_init(length, image, NULL);
	if (err < 0) {
		goto out_close;
	}

	for (size_t remaining = length; remaining > 0;) {
		bytes_read = fs_read(&file, dl_buf, MIN(remaining, sizeof(dl_buf)));
		if (bytes_read <= 0) {
			err = bytes_read < 0 ? (int)bytes_read : -ENODATA;
			goto out_abort;
		}
		err = dfu_target_mcuboot_write(dl_buf, bytes_read);
		if (err < 0) {
			goto out_abort;
		}
		remaining -= bytes_read;
	}
	err = dfu_target_mcuboot_done(true);
	if (err == 0) {
		LOG_INF("nRF53 image %d staged: %zu bytes", image, length);
	}
	goto out_close;

out_abort:
	(void)dfu_target_mcuboot_done(false);
out_close:
	if (err) {
		fs_close(&file);
		return err;
	}
	return fs_close(&file);
}

static int apply_nrf91_update(enum sm_xdfu_image_type type, off_t offset, size_t length)
{
	const struct device *modem = DEVICE_DT_GET(DT_ALIAS(modem));
	struct net_if *iface = net_if_get_first_by_type(&NET_L2_GET_NAME(PPP));
	bool was_up;
	int err;
	int restore_err;

	if (iface == NULL) {
		return -ENODEV;
	}
	was_up = net_if_is_up(iface);
	if (was_up) {
		err = net_if_down(iface);
		if (err < 0) {
			return err;
		}
	}
	err = pm_device_action_run(modem, PM_DEVICE_ACTION_SUSPEND);
	if (err < 0 && err != -EALREADY) {
		LOG_ERR("Failed to suspend modem for XDFU: %d", err);
		goto restore_interface;
	}

	LOG_INF("Transferring nRF91 update type %d: offset %lld, size %zu",
		type, (long long)offset, length);
	err = sm_xdfu_run(modem, type, OTA_BUNDLE_PATH, offset, length);
	if (type == SM_XDFU_TYPE_FULL_MFW && err < 0) {
		LOG_ERR("Full-modem update failed; modem remains suspended for retry");
		return err;
	}
	restore_err = pm_device_action_run(modem, PM_DEVICE_ACTION_RESUME);
	if (restore_err < 0) {
		LOG_ERR("Failed to resume modem after XDFU: %d", restore_err);
		return err < 0 ? err : restore_err;
	}
	if (err == 0) {
		LOG_INF("nRF91 update transfer complete");
	}

restore_interface:
	if (was_up) {
		restore_err = net_if_up(iface);
		if (restore_err < 0) {
			LOG_ERR("Failed to restore PPP interface: %d", restore_err);
			if (err == 0) {
				err = restore_err;
			}
		}
	}
	return err;
}

int ota_bundle_apply(void)
{
	uint8_t digest[32];
	uint8_t expected_digest[32];
	struct ota_bundle bundle = {0};
	psa_hash_operation_t sha_ctx = {0};
	size_t header_len = 0;
	size_t digest_len = 0;
	uint64_t payload_offset;
	uint32_t remaining;
	ssize_t bytes_read;
	int err;
	bool sha_initialized = false;
	bool nrf53_staged = false;
	bool primary_staged = false;

	fs_file_t_init(&ota_file);
	err = fs_open(&ota_file, OTA_BUNDLE_PATH, FS_O_READ);
	if (err) {
		LOG_ERR("fs_open failed: %d", err);
		return err;
	}

	bytes_read = fs_read(&ota_file, dl_buf, sizeof(dl_buf));
	if (bytes_read <= 0) {
		err = bytes_read < 0 ? (int)bytes_read : -EBADMSG;
		LOG_ERR("Failed to read OTA bundle header: %d", err);
		goto out_close;
	}

	err = cbor_decode_ota_bundle(dl_buf, (size_t)bytes_read, &bundle, &header_len);
	if (err != ZCBOR_SUCCESS || header_len == 0 || header_len > (size_t)bytes_read) {
		LOG_ERR("Invalid OTA bundle header: %d", err);
		err = -EBADMSG;
		goto out_close;
	}

	memcpy(expected_digest, bundle.bundle_sha256.value, sizeof(expected_digest));

	err = fs_seek(&ota_file, (off_t)header_len, FS_SEEK_SET);
	if (err) {
		LOG_ERR("Failed to seek to OTA payload: %d", err);
		goto out_close;
	}

	psa_status_t psa_err = psa_crypto_init();
	if (psa_err != PSA_SUCCESS) {
		LOG_ERR("Failed to initialize PSA Crypto: %d", psa_err);
		err = -EIO;
		goto out_close;
	}
	psa_err = psa_hash_setup(&sha_ctx, PSA_ALG_SHA_256);
	if (psa_err != PSA_SUCCESS) {
		LOG_ERR("Failed to initialize SHA-256: %d", psa_err);
		err = -EIO;
		goto out_close;
	}
	sha_initialized = true;

	remaining = bundle.bundle_size;
	while (remaining > 0) {
		size_t read_size = remaining < sizeof(dl_buf) ? remaining : sizeof(dl_buf);

		bytes_read = fs_read(&ota_file, dl_buf, read_size);
		if (bytes_read <= 0) {
			err = bytes_read < 0 ? (int)bytes_read : -EBADMSG;
			LOG_ERR("Failed to read OTA payload: %d", err);
			goto out_free_sha;
		}
		psa_err = psa_hash_update(&sha_ctx, dl_buf, (size_t)bytes_read);
		if (psa_err != PSA_SUCCESS) {
			LOG_ERR("Failed to update SHA-256: %d", psa_err);
			err = -EIO;
			goto out_free_sha;
		}
		remaining -= (uint32_t)bytes_read;
	}

	bytes_read = fs_read(&ota_file, dl_buf, 1);
	if (bytes_read != 0) {
		LOG_ERR("OTA bundle has trailing data or could not be read");
		err = bytes_read < 0 ? (int)bytes_read : -EBADMSG;
		goto out_free_sha;
	}

	psa_err = psa_hash_finish(&sha_ctx, digest, sizeof(digest), &digest_len);
	sha_initialized = false;
	if (psa_err != PSA_SUCCESS || digest_len != sizeof(digest)) {
		LOG_ERR("Failed to finish SHA-256: %d", psa_err);
		err = -EIO;
		goto out_free_sha;
	}
	if (memcmp(digest, expected_digest, sizeof(digest)) != 0) {
		LOG_ERR("OTA bundle SHA-256 mismatch");
		err = -EBADMSG;
		goto out_free_sha;
	}
	err = 0;

	payload_offset = header_len;
	LOG_INF("OTA bundle valid: %u payload bytes, %zu elements; SHA-256 verified",
		bundle.bundle_size, bundle.ota_element_m_count);
	for (size_t i = 0; i < bundle.ota_element_m_count; i++) {
		const struct ota_element *element = &bundle.ota_element_m[i];

		LOG_INF("  %s: offset %llu, size %u bytes", ota_target_name(element->target_choice),
			(unsigned long long)payload_offset, element->size);
		payload_offset += element->size;
	}

	LOG_INF("expected size: %llu, actual size: %llu",
		(unsigned long long)bundle.bundle_size + header_len,
		(unsigned long long)payload_offset);
	if (payload_offset != (uint64_t)bundle.bundle_size + header_len) {
		LOG_ERR("OTA bundle element sizes do not match bundle_size");
		err = -EBADMSG;
	}

out_free_sha:
	if (sha_initialized) {
		(void)psa_hash_abort(&sha_ctx);
	}
out_close:
	if (err) {
		fs_close(&ota_file);
		return err;
	}
	err = fs_close(&ota_file);
	if (err) {
		return err;
	}

	payload_offset = header_len;
	err = -ENOTSUP;
	for (size_t i = 0; i < bundle.ota_element_m_count; i++) {
		const struct ota_element *element = &bundle.ota_element_m[i];

		switch (element->target_choice) {
		case ota_element_target_nrf53_app_m_c:
		case ota_element_target_nrf53_net_m_c:
		case ota_element_target_nrf53_bl_m_c:
			if (element->target_choice != ota_element_target_nrf53_net_m_c &&
			    primary_staged) {
				LOG_ERR("nRF53 app/bootloader staging partition is already primed");
				return -EBUSY;
			}
			err = stage_nrf53_update(
				element->target_choice == ota_element_target_nrf53_net_m_c ? 1 : 0,
				(off_t)payload_offset, element->size);
			if (err) {
				return err;
			}
			nrf53_staged = true;
			if (element->target_choice != ota_element_target_nrf53_net_m_c) {
				primary_staged = true;
			}
			break;
		case ota_element_target_nrf91_app_m_c:
			err = apply_nrf91_update(SM_XDFU_TYPE_APP, (off_t)payload_offset, element->size);
			if (err) {
				return err;
			}
			break;
		case ota_element_target_nrf91_mdm_delta_m_c:
			err = apply_nrf91_update(SM_XDFU_TYPE_DELTA_MFW, (off_t)payload_offset,
					 element->size);
			if (err) {
				return err;
			}
			break;
		case ota_element_target_nrf91_mdm_full_m_c:
			err = apply_nrf91_update(SM_XDFU_TYPE_FULL_MFW, (off_t)payload_offset,
					 element->size);
			if (err) {
				return err;
			}
			break;
		default:
			LOG_WRN("Not applying %s: target not implemented",
				ota_target_name(element->target_choice));
			break;
		}
		payload_offset += element->size;
	}
	if (nrf53_staged) {
		for (size_t i = 0; i < bundle.ota_element_m_count; i++) {
			const struct ota_element *element = &bundle.ota_element_m[i];

			if (element->target_choice != ota_element_target_nrf53_app_m_c &&
			    element->target_choice != ota_element_target_nrf53_net_m_c &&
			    element->target_choice != ota_element_target_nrf53_bl_m_c) {
				continue;
			}
			err = dfu_target_mcuboot_schedule_update(
				element->target_choice == ota_element_target_nrf53_net_m_c ? 1 : 0);
			if (err) {
				return err;
			}
		}
		LOG_INF("nRF53 updates scheduled; rebooting");
		sys_reboot(SYS_REBOOT_COLD);
	}
	return err;
}
```

## src/ota_download.h
```c
/*
 * Copyright (c) 2026 Nordic Semiconductor ASA
 *
 * SPDX-License-Identifier: LicenseRef-Nordic-5-Clause
 */

#ifndef OTA_DOWNLOAD_H_
#define OTA_DOWNLOAD_H_

#include <stdint.h>

/** Path of the downloaded OTA bundle on the external flash file system. */
#define OTA_BUNDLE_PATH "/ota/bundle.bin"

/**
 * @brief Download an OTA bundle to OTA_BUNDLE_PATH.
 *
 * Blocks until the download completes or fails. Any previous bundle is removed first,
 * and a partial bundle is removed on failure.
 *
 * @param url            HTTP(S) URL of the bundle.
 * @param sec_tags       TLS security tags, or NULL for plain HTTP.
 * @param sec_tag_count  Number of entries in @p sec_tags.
 *
 * @retval 0 on success, negative errno on failure.
 */
int ota_bundle_download(const char *url, const int *sec_tags, uint8_t sec_tag_count);

/**
 * @brief Verify the downloaded bundle and apply its supported update elements.
 *
 * Verifies element metadata, payload size, and SHA-256 before any transfer.
 * Suspends the modem and PPP interface, streams application, modem delta, or
 * full-modem firmware using AT#XDFU, and restores networking after success.
 * A failed full-modem update leaves the modem suspended for retry.
 * Network registration completes asynchronously. Other targets are not applied.
 * The nRF91 application must confirm its new MCUboot image after booting.
 * nRF53 app/net images are staged in their MCUboot secondary slots in file order.
 * nRF53 bootloader images share app staging; a second app/bootloader write is
 * rejected with -EBUSY. MCUboot copies a bootloader candidate into the inactive
 * S0/S1 bank on reboot, without direct bank writes by this application.
 * After all supported transfers succeed, only the staged nRF53 images are
 * scheduled and the host reboots. No nRF53 image is scheduled on a staging error.
 *
 * @retval 0 on success, negative errno on failure.
 * @retval -ENOTSUP if the bundle contains no supported update element.
 */
int ota_bundle_apply(void);

#endif /* OTA_DOWNLOAD_H_ */
```

## src/sm_xdfu.c
```c
/*
 * Copyright (c) 2026 Nordic Semiconductor ASA
 *
 * SPDX-License-Identifier: LicenseRef-Nordic-5-Clause
 */

#include <errno.h>
#include <stdarg.h>
#include <stdio.h>
#include <stdlib.h>
#include <string.h>
#include <psa/crypto.h>
#include <modem_update_decode.h>

#include <zephyr/drivers/gpio.h>
#include <zephyr/drivers/modem/modem_cellular.h>
#include <zephyr/fs/fs.h>
#include <zephyr/kernel.h>
#include <zephyr/logging/log.h>
#include <zephyr/modem/chat.h>
#include <zephyr/modem/pipe.h>
#include <zephyr/pm/device_runtime.h>

#include "sm_xdfu.h"

LOG_MODULE_REGISTER(sm_xdfu, LOG_LEVEL_INF);

#define XDFU_CHUNK_SIZE 4096
#define XDFU_WRITE_DONE BIT(0)
#define XDFU_APPLY_DONE BIT(1)
#define XDFU_FAILURE BIT(2)
#define XDFU_READY BIT(3)
#define XDFU_BOOTLOADER_READY BIT(4)
#define XDFU_WRITE_TIMEOUT K_SECONDS(10)

struct xdfu_full_image {
	struct Segments segments;
	size_t header_length;
	uint8_t metadata[1024];
};

struct xdfu_context {
	struct modem_chat chat;
	struct k_event events;
	struct modem_pipe *pipe;
	enum sm_xdfu_image_type type;
	bool data_mode;
	struct xdfu_full_image *full;
	uint8_t receive_buf[1024];
	uint8_t command[96];
	uint8_t *argv[4];
	uint8_t transfer_buf[256];
};

static K_MUTEX_DEFINE(xdfu_lock);

static bool xdfu_parse_number(const char *text, long *value)
{
	char *end;

	errno = 0;
	*value = strtol(text, &end, 10);
	if (end == text || errno == ERANGE) {
		return false;
	}
	while (*end == ' ' || *end == '\t') {
		end++;
	}
	return *end == '\0';
}

static void xdfu_on_result(struct modem_chat *chat, char **argv, uint16_t argc, void *user_data)
{
	struct xdfu_context *ctx = user_data;
	long type;
	long operation;
	long status;

	ARG_UNUSED(chat);
	if (argc != 4 || !xdfu_parse_number(argv[1], &type) ||
	    !xdfu_parse_number(argv[2], &operation) || !xdfu_parse_number(argv[3], &status)) {
		k_event_post(&ctx->events, XDFU_FAILURE);
		return;
	}
	if (type != ctx->type) {
		return;
	}
	if (status != 0) {
		k_event_post(&ctx->events, XDFU_FAILURE);
	} else if (operation == 1) {
		k_event_post(&ctx->events, XDFU_WRITE_DONE);
	} else if (operation == 2) {
		k_event_post(&ctx->events, XDFU_APPLY_DONE);
	}
}

static void xdfu_on_ready(struct modem_chat *chat, char **argv, uint16_t argc, void *user_data)
{
	struct xdfu_context *ctx = user_data;

	ARG_UNUSED(chat);
	ARG_UNUSED(argv);
	ARG_UNUSED(argc);
	k_event_post(&ctx->events, XDFU_READY);
}

static void xdfu_on_bootloader_ready(struct modem_chat *chat, char **argv, uint16_t argc,
				    void *user_data)
{
	struct xdfu_context *ctx = user_data;

	ARG_UNUSED(chat);
	ARG_UNUSED(argv);
	ARG_UNUSED(argc);
	k_event_post(&ctx->events, XDFU_BOOTLOADER_READY);
}

MODEM_CELLULAR_COMMON_CHAT_MATCHES();
MODEM_CHAT_MATCHES_DEFINE(xdfu_unsol,
	MODEM_CHAT_MATCH("#XDATAMODE: ", ",", NULL),
	MODEM_CHAT_MATCH("#XDFU:", ",", xdfu_on_result),
	MODEM_CHAT_MATCH("Bootloader mode ready", NULL, xdfu_on_bootloader_ready),
	MODEM_CHAT_MATCH("Ready", NULL, xdfu_on_ready));

static int xdfu_wait(struct xdfu_context *ctx, uint32_t event, k_timeout_t timeout)
{
	uint32_t result = k_event_wait(&ctx->events, event | XDFU_FAILURE, false, timeout);

	if (result & XDFU_FAILURE) {
		return -EIO;
	}
	return (result & event) ? 0 : -ETIMEDOUT;
}

static int xdfu_command(struct xdfu_context *ctx, const char *format, ...)
{
	va_list args;
	int length;

	va_start(args, format);
	length = vsnprintf((char *)ctx->command, sizeof(ctx->command), format, args);
	va_end(args);
	if (length < 0 || length >= sizeof(ctx->command)) {
		return -ENOBUFS;
	}

	struct modem_chat_script_chat command = {
		.request = ctx->command,
		.request_size = length,
		.response_matches = &ok_match,
		.response_matches_size = 1,
		.timeout = 1000,
	};
	struct modem_chat_script script = {
		.name = "xdfu_command",
		.script_chats = &command,
		.script_chats_size = 1,
		.abort_matches = abort_matches,
		.abort_matches_size = ARRAY_SIZE(abort_matches),
		.timeout = 30,
	};

	return modem_chat_run_script(&ctx->chat, &script);
}

static int xdfu_transmit(struct xdfu_context *ctx, const uint8_t *buffer, size_t length)
{
	k_timepoint_t deadline = sys_timepoint_calc(XDFU_WRITE_TIMEOUT);

	while (length > 0) {
		int written = modem_pipe_transmit(ctx->pipe, buffer, length);

		if (written < 0) {
			return written;
		}
		buffer += written;
		length -= written;
		if (length == 0) {
			return 0;
		}
		if (sys_timepoint_expired(deadline)) {
			return -ETIMEDOUT;
		}
		if (written == 0) {
			k_msleep(1);
		}
	}
	return 0;
}

static int xdfu_write_chunk(struct xdfu_context *ctx, struct fs_file_t *file, size_t length)
{
	while (length > 0) {
		size_t count = MIN(length, sizeof(ctx->transfer_buf));
		ssize_t bytes_read = fs_read(file, ctx->transfer_buf, count);

		if (bytes_read <= 0) {
			return bytes_read < 0 ? (int)bytes_read : -ENODATA;
		}
		int err = xdfu_transmit(ctx, ctx->transfer_buf, bytes_read);

		if (err < 0) {
			return err;
		}
		length -= bytes_read;
	}
	return 0;
}

static int xdfu_write_range(struct xdfu_context *ctx, struct fs_file_t *file,
			    uint32_t address, size_t length)
{
	for (size_t written = 0; written < length;) {
		size_t count = MIN(length - written, XDFU_CHUNK_SIZE);
		int err;

		k_event_clear(&ctx->events, XDFU_WRITE_DONE | XDFU_FAILURE);
		ctx->data_mode = true;
		err = xdfu_command(ctx, "AT#XDFUWRITE=%d,%u,%zu", ctx->type, address, count);
		if (err < 0) {
			return err;
		}
		err = xdfu_write_chunk(ctx, file, count);
		if (err < 0) {
			return err;
		}
		err = xdfu_wait(ctx, XDFU_WRITE_DONE, XDFU_WRITE_TIMEOUT);
		if (err < 0) {
			return err;
		}
		ctx->data_mode = false;
		written += count;
		address += count;
		LOG_INF("nRF91 XDFU type %d: %zu/%zu bytes", ctx->type, written, length);
	}
	return 0;
}

static int xdfu_apply(struct xdfu_context *ctx)
{
	int err;

	k_event_clear(&ctx->events, XDFU_APPLY_DONE | XDFU_FAILURE);
	err = xdfu_command(ctx, "AT#XDFUAPPLY=%d", ctx->type);
	if (err == 0) {
		err = xdfu_wait(ctx, XDFU_APPLY_DONE, K_SECONDS(30));
	}
	return err;
}

static int xdfu_prepare_full(struct xdfu_context *ctx, struct fs_file_t *file,
			     off_t offset, size_t length)
{
	struct COSE_Sign1_Manifest wrapper;
	psa_hash_operation_t hash = PSA_HASH_OPERATION_INIT;
	uint8_t digest[32];
	size_t bytes_read = 0;
	size_t decoded_length;
	size_t remaining;
	int err;

	ctx->full = calloc(1, sizeof(*ctx->full));
	if (!ctx->full) {
		return -ENOMEM;
	}
	while (bytes_read < MIN(length, sizeof(ctx->full->metadata))) {
		ssize_t count = fs_read(file, ctx->full->metadata + bytes_read,
				MIN(length, sizeof(ctx->full->metadata)) - bytes_read);

		if (count <= 0) {
			return count < 0 ? (int)count : -ENODATA;
		}
		bytes_read += count;
	}
	if (cbor_decode_Wrapper(ctx->full->metadata, bytes_read, &wrapper,
				&ctx->full->header_length) != ZCBOR_SUCCESS ||
	    ctx->full->header_length >= length) {
		LOG_ERR("Invalid full-modem CBOR wrapper");
		return -EBADMSG;
	}
	const struct Manifest *manifest = &wrapper.COSE_Sign1_Manifest_payload_cbor;

	if (manifest->Manifest_blob_hash.len != sizeof(digest) ||
	    cbor_decode_Segments(manifest->Manifest_segments.value,
				 manifest->Manifest_segments.len, &ctx->full->segments,
				 &decoded_length) != ZCBOR_SUCCESS ||
	    decoded_length != manifest->Manifest_segments.len ||
	    ctx->full->segments.Segments_Segment_m_count < 2) {
		LOG_ERR("Invalid full-modem segment table");
		return -EBADMSG;
	}

	remaining = length - ctx->full->header_length;
	for (size_t index = 0; index < ctx->full->segments.Segments_Segment_m_count; index++) {
		const struct Segment *segment = &ctx->full->segments.Segments_Segment_m[index];

		if (segment->Segment_len == 0 || segment->Segment_len > remaining ||
		    segment->Segment_len > UINT32_MAX - segment->Segment_target_addr) {
			LOG_ERR("Full-modem segment %zu is outside the supplied image range", index);
			return -EBADMSG;
		}
		remaining -= segment->Segment_len;
	}
	if (remaining != 0) {
		LOG_ERR("Full-modem segment sizes do not match the image size");
		return -EBADMSG;
	}
	err = fs_seek(file, offset + ctx->full->header_length, FS_SEEK_SET);
	if (err < 0) {
		return err;
	}
	err = psa_crypto_init();
	if (err == PSA_SUCCESS) {
		err = psa_hash_setup(&hash, PSA_ALG_SHA_256);
	}
	if (err != PSA_SUCCESS) {
		return -EIO;
	}
	remaining = length - ctx->full->header_length;
	while (remaining > 0) {
		ssize_t count = fs_read(file, ctx->transfer_buf,
				MIN(remaining, sizeof(ctx->transfer_buf)));

		if (count <= 0) {
			(void)psa_hash_abort(&hash);
			return count < 0 ? (int)count : -ENODATA;
		}
		err = psa_hash_update(&hash, ctx->transfer_buf, count);
		if (err != PSA_SUCCESS) {
			(void)psa_hash_abort(&hash);
			return -EIO;
		}
		remaining -= count;
	}
	err = psa_hash_finish(&hash, digest, sizeof(digest), &decoded_length);
	(void)psa_hash_abort(&hash);
	if (err != PSA_SUCCESS || decoded_length != sizeof(digest)) {
		return -EIO;
	}
	if (memcmp(digest, manifest->Manifest_blob_hash.value, sizeof(digest)) != 0) {
		LOG_ERR("Full-modem firmware blob SHA-256 mismatch");
		return -EBADMSG;
	}
	return fs_seek(file, offset + ctx->full->header_length, FS_SEEK_SET);
}

static int xdfu_full_run(struct xdfu_context *ctx, struct fs_file_t *file)
{
	int err;

	k_event_clear(&ctx->events, XDFU_BOOTLOADER_READY | XDFU_READY | XDFU_FAILURE);
	err = xdfu_command(ctx, "AT#XDFUINIT=2");
	if (err < 0) {
		return err;
	}
	err = xdfu_wait(ctx, XDFU_BOOTLOADER_READY, K_SECONDS(30));
	if (err < 0) {
		return err;
	}
	LOG_WRN("Full-modem update: interrupted programming requires a complete retry");
	for (size_t index = 0; index < ctx->full->segments.Segments_Segment_m_count; index++) {
		const struct Segment *segment = &ctx->full->segments.Segments_Segment_m[index];

		LOG_INF("Full-modem segment %zu/%zu: address 0x%x, size %u", index + 1,
			ctx->full->segments.Segments_Segment_m_count,
			segment->Segment_target_addr, segment->Segment_len);
		err = xdfu_write_range(ctx, file, segment->Segment_target_addr, segment->Segment_len);
		if (err < 0) {
			return err;
		}
		if (index == 0) {
			err = xdfu_apply(ctx);
			if (err < 0) {
				return err;
			}
		}
	}
	k_event_clear(&ctx->events, XDFU_READY | XDFU_FAILURE);
	err = xdfu_apply(ctx);
	if (err == 0) {
		err = xdfu_wait(ctx, XDFU_READY, K_SECONDS(120));
	}
	return err;
}

int sm_xdfu_run(const struct device *modem, enum sm_xdfu_image_type type,
	       const char *file, off_t offset, size_t length)
{
	struct fs_dirent entry;
	struct fs_file_t fd;
	struct xdfu_context *ctx;
	bool attached = false;
	bool initialized = false;
	int err;

	if (!modem || !file || offset < 0 || length == 0 ||
	    (type != SM_XDFU_TYPE_APP && type != SM_XDFU_TYPE_DELTA_MFW &&
	     type != SM_XDFU_TYPE_FULL_MFW)) {
		return -EINVAL;
	}
	err = fs_stat(file, &entry);
	if (err < 0) {
		return err;
	}
	if (entry.type != FS_DIR_ENTRY_FILE || (uint64_t)offset > entry.size ||
	    length > entry.size - (size_t)offset) {
		return -EINVAL;
	}
	if (!device_is_ready(modem)) {
		return -ENODEV;
	}

	struct modem_cellular_data *data = modem->data;
	const struct modem_cellular_config *config = modem->config;

	if (!device_is_ready(config->uart)) {
		return -ENODEV;
	}
	if (pm_device_runtime_usage(modem) > 0 || pm_device_runtime_usage(config->uart) > 0) {
		return -EBUSY;
	}
	err = k_mutex_lock(&xdfu_lock, K_NO_WAIT);
	if (err < 0) {
		return -EBUSY;
	}
	ctx = calloc(1, sizeof(*ctx));
	if (!ctx) {
		err = -ENOMEM;
		goto out_unlock;
	}
	k_event_init(&ctx->events);
	ctx->type = type;
	fs_file_t_init(&fd);
	err = fs_open(&fd, file, FS_O_READ);
	if (err < 0) {
		goto out_free;
	}
	err = fs_seek(&fd, offset, FS_SEEK_SET);
	if (err < 0) {
		goto out_file;
	}
	if (type == SM_XDFU_TYPE_FULL_MFW) {
		err = xdfu_prepare_full(ctx, &fd, offset, length);
		if (err < 0) {
			goto out_file;
		}
	}

	const struct modem_chat_config chat_config = {
		.receive_buf = ctx->receive_buf,
		.receive_buf_size = sizeof(ctx->receive_buf),
		.delimiter = "\r",
		.delimiter_size = 1,
		.filter = "\n",
		.filter_size = 1,
		.argv = ctx->argv,
		.argv_size = ARRAY_SIZE(ctx->argv),
		.unsol_matches = xdfu_unsol,
		.unsol_matches_size = ARRAY_SIZE(xdfu_unsol),
		.user_data = ctx,
	};

	err = modem_chat_init(&ctx->chat, &chat_config);
	if (err < 0) {
		goto out_file;
	}
	ctx->pipe = data->uart_pipe;
	err = modem_pipe_close(ctx->pipe, K_SECONDS(1));
	if (err < 0) {
		goto out_file;
	}
	modem_pipe_release(ctx->pipe);
	err = modem_pipe_open(ctx->pipe, K_SECONDS(1));
	if (err < 0) {
		goto out_file;
	}
	err = modem_chat_attach(&ctx->chat, ctx->pipe);
	if (err < 0) {
		goto out_pipe;
	}
	attached = true;
	if (type == SM_XDFU_TYPE_FULL_MFW) {
		err = xdfu_full_run(ctx, &fd);
		if (err < 0) {
			LOG_ERR("Full-modem update failed (%d); retain the bundle and retry full DFU", err);
			if (ctx->data_mode) {
				initialized = true;
				goto out_reset;
			}
		}
		goto out_chat;
	}
	err = xdfu_command(ctx, "AT#XDFUINIT=%d,%zu", type, length);
	if (err < 0) {
		goto out_chat;
	}
	initialized = true;

	err = xdfu_write_range(ctx, &fd, 0, length);
	if (err == 0) {
		err = xdfu_apply(ctx);
	}

out_reset:
	if (initialized) {
		int reset_err;

		k_event_clear(&ctx->events, XDFU_READY | XDFU_FAILURE);
		if (ctx->data_mode) {
			if (config->reset_gpio.port == NULL) {
				reset_err = -ENOTSUP;
			} else {
				reset_err = gpio_pin_set_dt(&config->reset_gpio, 1);
				if (reset_err == 0) {
					k_msleep(MAX(config->vendor->reset_pulse_duration_ms, 1));
					reset_err = gpio_pin_set_dt(&config->reset_gpio, 0);
				}
			}
		} else {
			reset_err = xdfu_command(ctx, "AT#XRESET");
		}
		if (reset_err == 0) {
			reset_err = xdfu_wait(ctx, XDFU_READY, K_SECONDS(120));
		}
		if (reset_err < 0) {
			LOG_ERR("nRF91 reset/ready failed: %d", reset_err);
			if (err == 0) {
				err = reset_err;
			}
		}
	}
out_chat:
	if (attached) {
		modem_chat_release(&ctx->chat);
	}
out_pipe: {
	int close_err = modem_pipe_close(ctx->pipe, K_SECONDS(1));

	if (err == 0) {
		err = close_err;
	}
}
out_file: {
	int close_err = fs_close(&fd);

	if (err == 0) {
		err = close_err;
	}
}
out_free:
	free(ctx->full);
	free(ctx);
out_unlock:
	k_mutex_unlock(&xdfu_lock);
	return err;
}
```

## src/sm_xdfu.h
```c
/*
 * Copyright (c) 2026 Nordic Semiconductor ASA
 *
 * SPDX-License-Identifier: LicenseRef-Nordic-5-Clause
 */

#ifndef SM_XDFU_H_
#define SM_XDFU_H_

#include <stddef.h>
#include <sys/types.h>
#include <zephyr/device.h>

enum sm_xdfu_image_type {
	SM_XDFU_TYPE_APP = 0,
	SM_XDFU_TYPE_DELTA_MFW = 1,
	SM_XDFU_TYPE_FULL_MFW = 2,
};

/**
 * Transfer an nRF91 update from a file range using AT#XDFU.
 *
 * The caller must suspend the cellular driver and stop networking first.
 * Application and delta updates are scheduled and followed by a modem reset.
 * Full-modem updates decode a Nordic CBOR package, verify its firmware blob,
 * enter bootloader mode, and write addressed segments. Final apply reboots the
 * modem automatically. Returns after receiving Ready on success.
 * A failed full update may require a complete retry before the modem is usable.
 * A new application is responsible for confirming its MCUboot image.
 *
 * @return 0 on success, negative errno on failure.
 */
int sm_xdfu_run(const struct device *modem, enum sm_xdfu_image_type type,
	       const char *file, off_t offset, size_t length);

#endif
```
